#include <Arduino.h>
#include <Wire.h>
#include <U8g2lib.h> // library for drawing images to the OLED display
#include <Wire.h> // library requires for IIC communication
#include "happy.h"
#include "normal.h"
#include "tease.h"
#include "accelerate.h"
#include "lazy.h"
#include "heart.h"
#include "mean.h"

// MPU6050 address
const int MPU_addr = 0x68;
int16_t AcX, AcY;


U8G2_SSD1306_128X64_NONAME_F_HW_I2C u8g2(U8G2_R0, /* reset=*/ U8X8_PIN_NONE); // initialization for the used OLED display
unsigned long previousMillis = 0;
const unsigned long interval = 5000;  // Time between actions in ms

int repeatCount = 0;          // How many times to repeat current function
int currentFunction = -1;     // The function currently being repeated



int i;
int till;
void happy(){
  till = happyallArray_LEN;
  for(i=0;i<=till;i++){
    u8g2.clearBuffer();					// clear the internal memory
    u8g2.drawXBMP(0, 0, 128, 64, happyallArray[i]); // draw fullscreen image generated by image2cpp website
    u8g2.sendBuffer();					// transfer internal memory to the display
  }
}

void accelerate(){
  till = accelerateallArray_LEN;
  for(i=0;i<=till;i++){
    u8g2.clearBuffer();					// clear the internal memory
    u8g2.drawXBMP(0, 0, 128, 64, accelerateallArray[i]); // draw fullscreen image generated by image2cpp website
    u8g2.sendBuffer();					// transfer internal memory to the display
  }
}

void heart(){
  till = heartallArray_LEN;
  for(i=0;i<=till;i++){
    u8g2.clearBuffer();					// clear the internal memory
    u8g2.drawXBMP(0, 0, 128, 64, heartallArray[i]); // draw fullscreen image generated by image2cpp website
    u8g2.sendBuffer();					// transfer internal memory to the display
  }
}

void lazy(){
  till = lazyallArray_LEN;
  for(i=0;i<=till;i++){
    u8g2.clearBuffer();					// clear the internal memory
    u8g2.drawXBMP(0, 0, 128, 64, lazyallArray[i]); // draw fullscreen image generated by image2cpp website
    u8g2.sendBuffer();					// transfer internal memory to the display
  }
}

void mean(){
  till = meanallArray_LEN;
  for(i=0;i<=till;i++){
    u8g2.clearBuffer();					// clear the internal memory
    u8g2.drawXBMP(0, 0, 128, 64, meanallArray[i]); // draw fullscreen image generated by image2cpp website
    u8g2.sendBuffer();					// transfer internal memory to the display
  }
}

void tease(){
  till = teaseallArray_LEN;
  for(i=0;i<=till;i++){
    u8g2.clearBuffer();					// clear the internal memory
    u8g2.drawXBMP(0, 0, 128, 64, teaseallArray[i]); // draw fullscreen image generated by image2cpp website
    u8g2.sendBuffer();					// transfer internal memory to the display
  }
}
void normal(){
  till = normalallArray_LEN;
  for(i=0;i<till;i++){
    u8g2.clearBuffer();					// clear the internal memory
    u8g2.drawXBMP(0, 0, 128, 64, normalallArray[i]); // draw fullscreen image generated by image2cpp website
    u8g2.sendBuffer();					// transfer internal memory to the display
  }
}

void callFunction(int id) {
  switch (id) {
    case 0: happy(); break;
    case 1: normal();     break;
    case 2: lazy();       break;
    case 3: lazy();      break;
    case 4: heart();      break;
    case 5: mean();       break;
    case 6: happy();      break;
  }
}

void setup(void) {
  Wire.begin();
  Wire.beginTransmission(MPU_addr);
  Wire.write(0x6B);  // Power management register
  Wire.write(0);     // Wake up MPU6050
  Wire.endTransmission(true);

  Serial.begin(115200);

  // Start display
  u8g2.begin();
  u8g2.clearBuffer();
  u8g2.setFont(u8g2_font_ncenB08_tr);
  u8g2.drawStr(10, 32, "zintechideas");
  u8g2.sendBuffer();
  delay(3000);
}
int16_t prex=0,prey=0,dx=0,dy=0;

void loop(void) { // main loop
  bool run = true;
   // === Read accelerometer data ===
  Wire.beginTransmission(MPU_addr);
  Wire.write(0x3B);
  Wire.endTransmission(false);
  Wire.requestFrom(MPU_addr, 6, true);
  AcX = Wire.read() << 8 | Wire.read();
  AcY = Wire.read() << 8 | Wire.read();
  
  Serial.println(AcX);
  Serial.println(AcY);

  if(AcX<prex-6000 || AcX>prex+6000){
    accelerate();
    prex=AcX;
    delay(1000);
  }
  else if(AcY<prey-6000 || AcY>prey+6000){
      tease();
      prey=AcY;
      delay(1000);
  }

  unsigned long currentMillis = millis();
  if (currentMillis - previousMillis >= interval) {
    previousMillis = currentMillis;

    // Repeat the same function
    if (repeatCount > 0) {
      callFunction(currentFunction);
      normal(); // Always call normal after each
      repeatCount--;
    } else {
      // Choose a new random function and a new repeat count
      currentFunction = random(7); // Choose 0-6
      repeatCount = random(3, 8);  // Repeat 3 to 7 times
      Serial.print("Changing to new function: ");
      Serial.print(currentFunction);
      Serial.print(", will repeat ");
      Serial.print(repeatCount);
      Serial.println(" times.");
    }
  }
}
