#include <Wire.h>
#include <U8g2lib.h>
#include "bitmaps.h"
#include "bitmapscopy.h"

// Initialize U8g2 for SSD1306 128x64 OLED over I2C (no reset pin)
U8G2_SSD1306_128X64_NONAME_F_HW_I2C u8g2(U8G2_R0, /* reset=*/ U8X8_PIN_NONE);


const int MPU_addr = 0x68;
int16_t AcX, AcY, AcZ;

float x, y;

void setup() {
  Wire.begin();
  Wire.beginTransmission(MPU_addr);
  Wire.write(0x6B);  // Power management register
  Wire.write(0);     // Wake up MPU6050
  Wire.endTransmission(true);

  Serial.begin(9600);

  // Start display
  u8g2.begin();
  u8g2.clearBuffer();
  u8g2.setFont(u8g2_font_ncenB08_tr);
  u8g2.drawStr(10, 32, "zintechideas");
  u8g2.sendBuffer();
  delay(3000);
}
int frame; // which image to display on the display
float zprev;
float z=0;

void loop() {
  // Read raw accelerometer data
  Wire.beginTransmission(MPU_addr);
  Wire.write(0x3B);
  Wire.endTransmission(false);
  Wire.requestFrom(MPU_addr, 6, true);

  AcX = Wire.read() << 8 | Wire.read();
  AcY = Wire.read() << 8 | Wire.read();
  AcZ = Wire.read() << 8 | Wire.read();

  // Convert to g-force
  float ax = AcX / 16384.0;
  float ay = AcY / 16384.0;
  float az = AcZ / 16384.0;

  // Isolated angle calculation
  zprev=z;
  x = RAD_TO_DEG * atan(ax);
  y = RAD_TO_DEG * atan(ay);
  z = RAD_TO_DEG * atan(az);

  // Serial output
  //Serial.print("AngleX = "); Serial.println(x);
  //Serial.print("AngleY = "); Serial.println(y);
  //Serial.print("AngleZ = "); Serial.println(z);
  //Serial.println("--------------------");


  delay(200);
  if(z!=zprev){
  while(frame<=61){
   // increase the frame number
    // only go between 0-89, since we only have 90 images
    u8g2.clearBuffer();					// clear the internal memory
    u8g2.drawXBMP(0, 0, 128, 64, epd_bitmap_allArray[frame]); // draw fullscreen image generated by image2cpp website
    u8g2.sendBuffer();	
    frame++;
  }
  frame = 0;
  }
  if(z!=zprev){
  while(frame<=61){
   // increase the frame number
    // only go between 0-89, since we only have 90 images
    u8g2.clearBuffer();					// clear the internal memory
    u8g2.drawXBMP(0, 0, 128, 64, epd_bitmap_allArrayw[frame]); // draw fullscreen image generated by image2cpp website
    u8g2.sendBuffer();	
    frame++;
  }
  frame = 0;
  }
  delay(200);
}
